## config/boards/shields/mac3/Kconfig.defconfig
```kconfig
# Copyright (c) 2020 The ZMK Contributors
# SPDX-License-Identifier: MIT

if SHIELD_MAC3_DONGLE

config ZMK_KEYBOARD_NAME
	default "mac3_dongle"
	
config ZMK_SPLIT_BLE_ROLE_CENTRAL
	default y
	
config ZMK_USB
	default y

endif

if ZMK_DISPLAY

config I2C
    default y

config SSD1306
    default y

choice ZMK_DISPLAY_WORK_QUEUE
    default ZMK_DISPLAY_WORK_QUEUE_DEDICATED
endchoice

endif



if SHIELD_MAC3 || SHIELD_MAC3_DONGLE 

config ZMK_BLE
	default y
	
config ZMK_SPLIT
	default y

endif
if LVGL

config LV_Z_VDB_SIZE
    default 64

config LV_DPI_DEF
    default 148

config LV_Z_BITS_PER_PIXEL
    default 1

choice LV_COLOR_DEPTH
    default LV_COLOR_DEPTH_1
endchoice

endif
```

## config/boards/shields/mac3/Kconfig.shield
```kconfig
config SHIELD_MAC3
    def_bool $(shields_list_contains,mac3)

config SHIELD_MAC3_DONGLE
    def_bool $(shields_list_contains,mac3_dongle)
```
